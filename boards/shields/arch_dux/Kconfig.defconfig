## boards/shields/arch_dux/Kconfig.defconfig
```kconfig
if SHIELD_A_DUX_DONGLE

config ZMK_KEYBOARD_NAME
    default "A. Dux"

config ZMK_SPLIT_ROLE_CENTRAL
    default y

config ZMK_SPLIT
    default y

config ZMK_SPLIT_BLE_CENTRAL_PERIPHERALS
    default 2

config BT_MAX_CONN
    default 7

config BT_MAX_PAIRED
    default 7

endif

if SHIELD_A_DUX_LEFT || SHIELD_A_DUX_RIGHT

config ZMK_SPLIT
    default y

endif
```

## boards/shields/arch_dux/Kconfig.shield
```kconfig
# Copyright (c) 2021 The ZMK Contributors
# SPDX-License-Identifier: MIT

config SHIELD_ARCH_DUX_LEFT
    def_bool $(shields_list_contains,arch_dux_left)

config SHIELD_ARCH_DUX_RIGHT
    def_bool $(shields_list_contains,arch_dux_right)

config SHIELD_ARCH_DUX_DONGLE
    def_bool $(shields_list_contains,arch_dux_dongle)
```
